## main/Kconfig.projbuild
```kconfig
menu "Weather Station"

    config WS_DEVICE_NAME
        string "Station name"
        default ""
        help
            Free-text name of this station, e.g. "Varanda" (FR-10.2), up to
            32 characters. For people only: shown by `sys`, on the web page
            and in the MQTT info message. The station is identified by its
            device identifier, derived from the MAC address (FR-10.1).

    config WS_MEASURE_PERIOD_S
        int "Measurement interval (seconds)"
        range 1 3600
        default 2
        help
            How often the BME280 is read (FR-1.4, FR-3.2).

    config WS_LOG_PERIOD_S
        int "History log interval (seconds)"
        range 1 86400
        default 60
        help
            How often the latest measurement is stored in the flash history
            (FR-7.2). With the 5 MB partition, 60 s keeps about 7.4 months.

    config WS_ALTITUDE_M
        int "Altitude of the station (metres)"
        range -500 9000
        default 0
        help
            Height of the station above mean sea level, including the floor
            it stands on (FR-11.2). Used to reduce the measured pressure to
            sea level (QNH), as weather services report it. About 8 m of
            error give 1 hPa of error. 0 = sea level.

    config WS_METAR_STATION
        string "METAR airport for the pressure check (ICAO code)"
        default ""
        help
            ICAO code of a nearby airport, e.g. SBGR (FR-11.4). Once an hour
            the station fetches its METAR from aviationweather.gov over HTTPS
            and compares its own sea-level pressure with the airport QNH; the
            median difference is shown by `sys`, the web page and MQTT, with
            a suggested correction. Nothing is changed automatically. Pick an
            airport less than about 50 km away. Leave empty to disable (no
            request leaves the station). Needs Wi-Fi.

    config WS_DISPLAY_TIMEOUT_MIN
        int "Display switch-off after inactivity (minutes)"
        range 0 1440
        default 5
        help
            The OLED switches off when the BOOT button has not been pressed
            (and no display command was given) for this time (FR-9.2).
            Pressing the button switches it on again. 0 = never.

    config WS_WIFI_SSID
        string "Wi-Fi SSID"
        default ""
        help
            Network used to get the time of day via NTP. Leave empty to
            disable Wi-Fi. Stored only in the local sdkconfig (not committed).

    config WS_WIFI_PASSWORD
        string "Wi-Fi password"
        default ""
        help
            Password of the Wi-Fi network. Leave empty for an open network.

    config WS_MQTT_BROKER_URI
        string "MQTT broker URI"
        default ""
        help
            Broker that receives the weather data (FR-6.1), for example
            mqtt://192.168.1.10:1883 or mqtts://broker.example.com:8883.
            Leave empty to disable data transmission. Needs Wi-Fi.

    config WS_MQTT_USERNAME
        string "MQTT username"
        default ""
        help
            Leave empty if the broker does not require authentication.

    config WS_MQTT_PASSWORD
        string "MQTT password"
        default ""
        help
            Password of the MQTT user. Stored only in the local sdkconfig.

    config WS_MQTT_PUBLISH_PERIOD_S
        int "MQTT publish interval (seconds)"
        range 1 86400
        default 60
        help
            How often the latest measurement is sent to the broker (FR-6.2).

endmenu
```
